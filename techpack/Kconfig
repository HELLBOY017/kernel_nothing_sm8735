## techpack/Kconfig
```kconfig
menu "Techpack Drivers"

source "techpack/datarmnet/core/Kconfig"

source "techpack/datarmnet-ext/aps/Kconfig"

source "techpack/datarmnet-ext/mem/Kconfig"

source "techpack/datarmnet-ext/offload/Kconfig"

source "techpack/datarmnet-ext/perf/Kconfig"

source "techpack/datarmnet-ext/perf_tether/Kconfig"

source "techpack/datarmnet-ext/sch/Kconfig"

source "techpack/datarmnet-ext/shs/Kconfig"

source "techpack/datarmnet-ext/wlan/Kconfig"

source "techpack/bt-kernel/rtc6226/Kconfig"

source "techpack/bt-kernel/pwr/Kconfig"

source "techpack/bt-kernel/slimbus/Kconfig"

source "techpack/bt-kernel/btfmcodec/Kconfig"

source "techpack/bt-kernel/soundwire/Kconfig"

endmenu
```

## techpack/datarmnet-ext/mem/Kconfig
```kconfig
#
# RMNET_MEM driver
#

config RMNET_MEM
    tristate "Rmnet MEM  support"
    default m
    help
        Memory module for RmNet driver
```
